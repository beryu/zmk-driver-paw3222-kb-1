## Kconfig
```kconfig
menuconfig PAW3222
    bool "PAW3222 mouse optical sensor"
  select SPI
    help
      Enable PAW3222 mouse optical sensor.

config PAW3222_SMART_SCROLL
    bool "Enable smart scroll with sigmoid acceleration"
    default n
    help
      Enable sigmoid-based acceleration and base sensitivity scaling for
      scroll output. Also adds a remainder buffer that is
      reset after 100 ms of inactivity, preventing the buffering artefact
      that occurs when using zip_xy_scaler.
      This feature connects directly to ZMK's layer state.

config PAW3222_SMART_SCROLL_LAYER
    int "ZMK layer number to activate smart scroll"
    default 2
    depends on PAW3222_SMART_SCROLL
    help
      When this ZMK layer is active, the driver still sends INPUT_REL_X
      and INPUT_REL_Y events, but applies the configured acceleration
      and base sensitivity scaling. This relies on ZMK's scroll mapper
      (zip_xy_to_scroll_mapper) in the overlay to convert them into
      actual scroll events.

config PAW3222_BASE_SENSITIVITY_PERCENT
    int "Base output sensitivity (1-100 percent)"
    default 5
    range 1 100
    depends on PAW3222_SMART_SCROLL
    help
      Scales the raw X/Y values by this percentage before applying sigmoid
      acceleration. 5 means the sensor output is 5% of the raw value at
      slow speeds. Fast motion is amplified by the sigmoid curve.

config PAW3222_SCROLL_SENSITIVITY
    int "Sigmoid acceleration sensitivity (1-10)"
    default 2
    range 1 10
    depends on PAW3222_SMART_SCROLL
    help
      Controls how aggressively the sigmoid curve boosts fast motion.
      Higher values make the acceleration effect stronger.

config PAW3222_MOTION_INTERVAL_MS
    int "Delay after reading motion, in milliseconds"
    default 15
    range 1 100
    depends on PAW3222
    help
      Sensor transfer time is added to this delay. Shorter intervals improve
      motion reporting frequency at the cost of CPU time and power usage.
```
